## CMakeLists.txt
```
cmake_minimum_required(VERSION 3.24.2)

set(project_name multi_thread)
project(${project_name}  VERSION 1.0)

set(BOARD rpi_pico)
 find_package(Zephyr REQUIRED HINTS $ENV{ZEPHYR_BASE})

target_sources(app PRIVATE  src/main.c  src/threads.c)
```

## prj.conf
```kconfig
CONFIG_GPIO=y;
CONFIG_PRINTK=y;
CONFIG_TIMESLICING=y
CONFIG_TIMESLICE_SIZE=10
CONFIG_TIMESLICE_PRIORITY=0
CONFIG_SERIAL=y
```

## rpi_pico.overlay
```dts
/{
    leds{
    led_user:led_1{
        gpios=<&gpio0 5 GPIO_ACTIVE_HIGH>;
        label="led2";
    };
    };
    aliases{
       led=&led_user;
    };

};
```

## src/main.c
```c
// edited by Joseph Mbayi March 30 2023

// trial 1.0 to check on the zephyr multi threading capabilities

#include"../include/sys_deps.h"
#include"../include/threads.h"

 int main()
{
    // check if gpio devices are ready for use
    k_work_queue_init(&offload_work_q);
    if (!gpio_is_ready_dt(&led1))
    {
        printk("pin  %d is not ready name: %s", led1.pin, led1.port->name);
        return 1;
    }
    if (!gpio_is_ready_dt(&led2))
    {
        printk("pin %d is not ready name: %s", led2.pin, led2.port->name);
        return 1;
    }

    // configure gpio pins
    if (gpio_pin_configure_dt(&led1, GPIO_OUTPUT)!=0)
    {
        printk("gpio pin configuration failure");
      return 1;
    }
    if(gpio_pin_configure_dt(&led2,GPIO_OUTPUT)!=0){
        printk("gpio pin configuration failure");
    }
      strcpy(my_work.name, "Thread0 emulate_work()");
       k_work_init(&my_work.work,&offload_function);
    
        /*while(1){
             gpio_pin_toggle_dt(&led1);
             k_msleep(500);

        }*/
    
    return 0;
}

K_THREAD_DEFINE(blink_led1_id,STACK_SIZE,blink_1,NULL,NULL,NULL,2,0,0);
K_THREAD_DEFINE(blink_led2_id,STACK_SIZE,blink_2,NULL,NULL,NULL,4,0,0);

K_THREAD_DEFINE(thread0_id, STACKSIZE, thread0, NULL, NULL, NULL,
		THREAD0_PRIORITY, 0, 0);
        
K_THREAD_DEFINE(thread1_id, STACKSIZE, thread1, NULL, NULL, NULL,
		THREAD1_PRIORITY, 0, 0);
```

## include/sys_deps.h
```c
#ifndef SYS_DEPS_H

#define SYS_DEPS_H
#include <zephyr/kernel.h>
#include <zephyr/device.h>
#include <zephyr/drivers/gpio.h>
#include<zephyr/sys/printk.h>
#include<zephyr/sys/util.h>
#include<string.h>


// get data from the device tree
static const struct gpio_dt_spec led1 = GPIO_DT_SPEC_GET(DT_ALIAS(led0), gpios);
static const struct gpio_dt_spec led2 = GPIO_DT_SPEC_GET(DT_ALIAS(led), gpios);



#endif
```

## include/threads.h
```c
#ifndef THREADS_H

#define THREADS_H
#include"sys_deps.h"

#define STACK_SIZE 1024
#define STACKSIZE STACK_SIZE
#define THREAD0_PRIORITY 2 
#define THREAD1_PRIORITY 3
#define WORKQ_PRIORITY   4

// define work queue parameters
K_THREAD_STACK_DEFINE(workq_stack,512);
// queue to hold a list of un processed work
struct k_work_q offload_work_q;

struct work_info{
        struct k_work work;
        char name[25];
 }my_work;
// function declarations 
void blink_1();
void blink_2();
void offload_function(struct k_work *work_term);
void thread0(void);
void thread1(void);
void emulate_work();

#endif
```

## src/threads.c
```c
#include"../include/threads.h"

//function to blink the first led on pin 25

void blink_1()
{
    while(1)
    {
        gpio_pin_toggle_dt(&led1);
        printk("led2 blinking");
        
        k_msleep(500);
    }
}
// function to blink the second led on pin 5
void blink_2()
{
    while(1)
    {
        gpio_pin_toggle_dt(&led2);
        printk("Led 1 blinking");
       
        k_msleep(500);
    }
}
void emulate_work()
{
	for(volatile int count_out = 0; count_out < 150000; count_out ++);
}

 void offload_function(struct k_work *work_term)
{
    emulate_work();
}


void thread0(void)
{   
    
    uint64_t time_stamp;
    int64_t delta_time;
    // initialize and start work queue
     
      //k_work_queue_start(&offload_work_q,workq_stack,K_KERNEL_STACK_SIZEOF(workq_stack),5,NULL);
      
     
    while (1) {
        time_stamp = k_uptime_get();
        // submit work to user defined work queue
        //k_work_submit_to_queue(&offload_work_q, &my_work.work);
            
        // submit work to the system queue
        k_work_submit(&my_work.work);
        delta_time = k_uptime_delta(&time_stamp);
        printk("thread0 yielding this round in %lld ms\n", delta_time);
        k_msleep(20);
    }
}


void thread1(void)
{
    uint64_t time_stamp;
    int64_t delta_time;
    while (1) {
        time_stamp = k_uptime_get();
        emulate_work();
        delta_time = k_uptime_delta(&time_stamp);
        printk("thread1 yielding this round in %lld ms\n", delta_time);
        k_msleep(20);
    }
}
```
